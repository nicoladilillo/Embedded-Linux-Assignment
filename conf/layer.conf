## conf/layer.conf
```bitbake
# We have a conf and classes directory, add to BBPATH
BBPATH .= ":${LAYERDIR}"

# We have recipes-* directories, add to BBFILES
BBFILES += "${LAYERDIR}/recipes-*/*/*.bb \
            ${LAYERDIR}/recipes-*/*/*.bbappend"

BBFILE_COLLECTIONS += "assignment"
BBFILE_PATTERN_assignment = "^${LAYERDIR}/"
BBFILE_PRIORITY_assignment = "6"

LAYERDEPENDS_assignment = "core"
LAYERSERIES_COMPAT_assignment = "dunfell"
```
